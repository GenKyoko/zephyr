## dts/bindings/cpu/loongson,la264.yaml
```yaml
# SPDX-License-Identifier: Apache-2.0

description: Loongson LA264 (LoongArch 64-bit) CPU

compatible: "loongson,la264"

include: cpu.yaml
```

## dts/bindings/cpu/loongson,la464.yaml
```yaml
# Copyright (c) 2026 Zephyr Project Contributors
# SPDX-License-Identifier: Apache-2.0

description: Loongson LA464 (LoongArch 64-bit) CPU

compatible: "loongson,la464"

include: cpu.yaml
```

## dts/bindings/gpio/loongson,ls2k0300-gpio.yaml
```yaml
# Copyright (c) 2026 Zephyr Project Contributors
# SPDX-License-Identifier: Apache-2.0

description: |
  Loongson 2K0300 (and compatible 2K series SoC) GPIO controller.

  The IP is a "byte controlled" GPIO block: every pin owns one byte in each
  of the following regions, all relative to the controller base address
  (offsets as in the mainline Linux driver, BYTE_CTRL_MODE for ls2k0300):

    0x800  configuration / direction: bit0 = 1 -> input, bit0 = 0 -> output
    0x900  output value (bit0)
    0xa00  input value  (bit0)

  (The interrupt related regions of the block - 0xb00 .. 0xfff - are not
  modelled by this driver yet.)

  The pin count is given by "ngpios"; the pin index inside the IP block of
  the first pin of this instance is given by "loongson,pin-base" (the device
  tree splits the 106 pin block into banks of at most 32 pins so that the
  Zephyr pin numbers stay inside the 32 bit port mask).

compatible: "loongson,ls2k0300-gpio"

include: [gpio-controller.yaml, base.yaml]

properties:
  reg:
    required: true

  ngpios:
    required: true

  loongson,pin-base:
    type: int
    description: |
      Pin index inside the IP block of pin 0 of this bank (default 0).

gpio-cells:
  - pin
  - flags
```

## dts/bindings/i2c/loongson,ls2k0300-i2c.yaml
```yaml
# Copyright (c) 2026 Zephyr Project Contributors
# SPDX-License-Identifier: Apache-2.0

description: |
  Loongson 2K0300 "fast I2C" controller.

  The peripheral has 32 bit registers on a 4 byte stride
  (CR1/CR2/OAR/DR/SR1/SR2/CCR/TRISE/FLTR): start, stop and acknowledge are
  generated through CR1, and the transfer state is in the level flags of SR1
  and SR2. The Zephyr driver polls those flags, so the controller needs no
  interrupt line - "interrupts" is carried to stay faithful to mainline and for
  a future interrupt driven implementation.

  The input clock comes from "clocks" (the APB bus clock). It is programmed
  into CR2.FREQ in MHz and used to derive CCR, which is why "clock-frequency"
  keeps its usual Zephyr meaning of the I2C bus speed.

  Mainline names this compatible "loongson,ls2k0300-i2c"
  (drivers/i2c/busses/i2c-ls2x-v2.c). The 6.12 device tree still called it
  "loongson,lsfs-i2c", which is a different controller - the "loongson,ls2k-i2c"
  block of drivers/i2c/busses/i2c-ls2x.c with byte registers at 0x00..0x04.

compatible: "loongson,ls2k0300-i2c"

include: [i2c-controller.yaml, pinctrl-device.yaml]

properties:
  reg:
    required: true

  clocks:
    required: true

  clock-frequency:
    description: |
      Initial bus clock in Hz. The controller supports standard mode (100 kHz)
      and fast mode (400 kHz).

examples:
  - |
    i2c1: i2c@8000000016109000 {
            compatible = "loongson,ls2k0300-i2c";
            reg = <0x80000000 0x16109000 0x0 0x1000>;
            clocks = <&clk LS2K0300_CLK_I2C>;
            clock-frequency = <100000>;
            pinctrl-0 = <&i2c1_g50_default &i2c1_g51_default>;
            pinctrl-names = "default";
            status = "okay";
    };
```

## dts/bindings/i2s/loongson,ls2k0300-i2s.yaml
```yaml
# SPDX-License-Identifier: Apache-2.0

description: |
  Loongson 2K0300 I2S controller ("IIS", user manual chapter 11).

  The block has a register file with a version register, a format register
  (channel word length, transmit/receive sample depth, bit clock divider), a
  control register (master/slave, bit order, transmit/receive enable, soft
  reset, MCLK output enable) and two 8 byte FIFO ports, one per direction. The
  codec system clock (MCLK) is derived from the controller clock through a
  fractional divider in "IISConfig1".

  The FIFOs are fed by the LSIA DMA controller: one circular channel per
  direction over a two block ring, paced by the controller's own data
  requests, the way the vendor's Linux driver does it. The interrupt sources
  of the block itself are left disabled - the manual defines them as FIFO
  overflow/underflow notifications, which cannot be used as a pacing signal.

compatible: "loongson,ls2k0300-i2s"

include: [i2s-controller.yaml, base.yaml, pinctrl-device.yaml]

properties:
  reg:
    required: true

  clocks:
    required: true

  slave-mode:
    type: boolean
    description: |
      The controller receives the bit clock and the frame clock instead of
      generating them. The vendor device tree calls this "slave-mode", and the
      driver of the 2K0300 board leaves it off: its machine driver configures
      the link with SND_SOC_DAIFMT_CBS_CFS, i.e. this controller is the master
      and the codec the slave.

      The setting has to match the wiring; a configuration request that asks
      for the other role is refused with -EINVAL.

  loongson,bclk-from-reference:
    type: boolean
    description: |
      What the bit clock divider counts. By default it divides the system clock
      (IISConfig1's fractional divider output), which is what the vendor driver
      does on the revision it calls 1, and the driver then picks the division so
      that BCLK comes out as an exact multiple of the frame rate.

      With this property the divider is taken to count the block's reference
      clock directly instead (the vendor driver's revision 0 model). That
      division generally cannot hit the frame rate exactly, so the driver uses
      the rate it really produces and derives the system clock from it, keeping
      the ratio the codec's rate register describes intact.

      Which one a given SoC revision implements is not documented - the vendor
      driver decides by the revision it reads from the PCI device, which the
      2K0300 does not have. Worth trying when the bit clock seems wrong by a
      fixed factor (a codec fed a bit clock several times too fast is heard as
      noise, not as audio).

  loongson,mclk-xfs:
    type: int
    default: 128
    description: |
      The system clock (MCLK) as a multiple of the frame rate - the "xfs" of
      the vendor driver. Its device trees never set it, so its default of 128
      is what the working configuration on this SoC programs:
      MCLK = 128 * frame rate = 6.144 MHz at 48 kHz, with the bit clock
      divider (BCLK_RATIO) taken as MCLK/(2*BCLK) - 1.

  loongson,dmas:
    type: phandle-array
    description: |
      The DMA controller that moves the data, and the channels its requests are
      wired to: <&lsia_dma transmit-channel receive-channel>. The requests are fixed in silicon - there is no request
      select register - so these two numbers are all a board has to get right;
      on the 2K0300 the I2S transmit request is on channel 1 and the receive
      request on channel 0, which is the mapping the vendor device tree uses
      ("dmas = <&dma 0 0xaf>, <&dma 1 0xbf>").

  loongson,data-in-gpios:
    type: phandle-array
    description: |
      The data input pin - the codec's data out - as a GPIO specifier
      (<&gpioN pin>). It has to be an input: this port's pin state only selects
      the function, and the pad direction register (GPIO_OEN, active low) is
      left as the boot loader found it. On this board that leaves all five
      interface pins as outputs, so without this the pad drives the codec's
      data line against it and the receive path reads nothing.

      Required: a board that leaves the pad direction to the boot loader has
      to name the pin here, or the receive path reads nothing.

  mclk-output:
    type: boolean
    description: |
      Drive the codec system clock (MCLK) on the MCLK pin. Boards whose codec
      is clocked from a fixed oscillator - as the 2K0300 board is, from a
      12.288 MHz can - leave this off so that nothing drives that pin.

      The MCLK pin is the first of the I2S pin group (GPIO76 on the 2K0300),
      which a board muxes through pinctrl like the other four.
```

## dts/bindings/interrupt-controller/loongson,cpu-interrupt-controller.yaml
```yaml
# Copyright (c) 2026 Zephyr Project Contributors
# SPDX-License-Identifier: Apache-2.0

description: |
  LoongArch CPU interrupt controller. The controller is part of the core and
  exposes up to 16 interrupt lines through ESTAT.IS / ECFG.LIE; it has no
  register block of its own.

compatible: "loongson,cpu-interrupt-controller"

include: [interrupt-controller.yaml, base.yaml]

interrupt-cells:
  - irq
  - priority
```

## dts/bindings/interrupt-controller/loongson,liointc.yaml
```yaml
# Copyright (c) 2026 Zephyr Project Contributors
# SPDX-License-Identifier: Apache-2.0

description: |
  Loongson LIOINTC (Local I/O interrupt controller), version 2.0.

  The LIOINTC aggregates 32 internal peripheral interrupt lines and forwards
  them to one CPU interrupt line (a LoongArch IP2..IP7 line delivered through
  ESTAT.IS/ECFG.LIE). "reg" describes the "main" register block, while the
  per-core pending status lives in a separate "isr0" block.

  Children are numbered in the SoC-wide flat Zephyr IRQ space, starting at
  the value of "zephyr,irq-base" (i.e. child N of this instance is
  zephyr,irq-base + N).

compatible: "loongson,liointc-2.0"

include: [interrupt-controller.yaml, base.yaml]

interrupt-cells:
  - irq
  - priority

properties:
  reg:
    required: true

  reg-names:
    required: true

  loongson,parent-int-bitmap:
    type: array
    required: true
    description: |
      Four 32-bit words. Bit N of word P is set when child N is routed to
      parent line P (the parent lines are the "int0".."int3" interrupts of
      the node).

  zephyr,irq-base:
    type: int
    required: true
    description: |
      Flat Zephyr IRQ number assigned to child 0 of this LIOINTC instance.
```

## dts/bindings/interrupt-controller/loongson,ls2k0300-eiointc.yaml
```yaml
# SPDX-License-Identifier: Apache-2.0

description: |
  Loongson EIOINTC - the extended I/O interrupt controller, called "EXTIOI"
  in the 2K0300 (LS2K0300) user manual. It is the modern replacement of the
  legacy LIOINTC: every peripheral interrupt gets its own vector (the 2K0300
  wires up to 128 of them, see table 3-48 of the manual) instead of sharing
  one of the 64 aggregated LIOINTC lines.

  The vector set is forwarded to one LoongArch CPU interrupt line (INT0..INT3,
  i.e. a LoongArch IP line delivered through ESTAT.IS/ECFG.LIE). Unlike the
  LIOINTC, the controller does not aggregate the sources: it routes them per
  group of 32 vectors through its map register, and reports the ones that
  reached the core in a per-core status register.

  The register file is part of the SoC system register window, so "reg"
  describes that window; the offsets the driver uses are the ones documented
  for the SoC (EIOINTC manual chapter "扩展 IO 中断"):

    0x0100  chip general configuration register 0 (bit 19 = extioi_en)
    0x14c0  EXTIOI_MAP, routing of the four vector groups
    0x1600  EXTIOI_IEN0..3, interrupt enable
    0x1640  EXTIOI_POL0..3, level polarity
    0x1800  EXTIOI_CORE_ISR0..3, routed status (write 1 clears)

  Vectors are numbered in the SoC-wide flat Zephyr IRQ space, starting at the
  value of "zephyr,irq-base" (vector N of this controller is
  zephyr,irq-base + N).

compatible: "loongson,ls2k0300-eiointc"

include: [interrupt-controller.yaml, base.yaml]

interrupt-cells:
  - irq
  - priority

properties:
  reg:
    required: true

  zephyr,irq-base:
    type: int
    required: true
    description: |
      Flat Zephyr IRQ number assigned to vector 0 of this controller.

  loongson,extioi-enable-bit:
    type: int
    default: 19
    description: |
      Bit of the chip general configuration register 0 (offset 0x100 of the
      register window) that enables the extended interrupt path. The 2K0300
      documents bit 19 ("extioi_en", default 0, off at reset), so the driver
      sets it as soon as the controller is initialized.
```

## dts/bindings/pinctrl/loongson,ls2k0300-pinmux.yaml
```yaml
# Copyright (c) 2026 Zephyr Project Contributors
# SPDX-License-Identifier: Apache-2.0

description: |
  Loongson 2K0300 pin mux.

  The controller is the GPIO_CFG register block at 0x1600_0490. Every GPIO pin
  owns two bits there (16 pins per 32 bit register). A state node describes
  exactly one pin, and a consumer references one state per pin:

    &pinctrl {
      uart0_rx_default: uart0_rx_default { pinmux = <40 3>; };
      uart0_tx_default: uart0_tx_default { pinmux = <41 3>; };
    };

    &uart0 {
      pinctrl-0 = <&uart0_rx_default &uart0_tx_default>;
      pinctrl-names = "default";
    };

  The function cell is written into the pin's two bit field:
    0 GPIO, 1 first alternate, 2 second alternate, 3 primary function.

  One pin per state keeps the devicetree cell indices literal, which the "pinmux"
  parsing in soc/loongson/ls2k300/pinctrl_soc.h relies on.

compatible: "loongson,ls2k0300-pinmux"

include: base.yaml

properties:
  reg:
    required: true

child-binding:
  description: |
    A pin mux state: one (GPIO number, function value) pair.

  properties:
    pinmux:
      type: array
      required: true
      description: |
        One (pin, function) pair, e.g. <40 3> for GPIO40 on its primary
        function. The function value configures the pin's two bit field in the
        GPIO_CFG registers.
```

## dts/bindings/pwm/loongson,ls2k-pwm-timer.yaml
```yaml
# SPDX-License-Identifier: Apache-2.0

description: |
  Loongson 2K0300 PWM front end of the ATIM/GTIM timer blocks.

  This node is the child of a "loongson,loongson-timers" node and carries no
  register block of its own: the parent owns "reg", the array writer, the
  clocks and the interrupt, exactly as in the vendor Linux device tree, where
  drivers/mfd/loongson-timers.c populates this node and
  drivers/pwm/pwm-ls-timer.c drives it. The Zephyr driver
  (drivers/pwm/pwm_loongson_ls_timer.c) reaches the registers through its parent
  node.

  Number of channels and the width of the auto reload register are probed at
  run time (by writing the channel enable bits and the ARR and reading back what
  sticks), so nothing about them has to be described here.

  The channel pins are muxed by the board: the vendor device tree has
  "atim3_pin_m0/m1" (GPIO30 / GPIO83), "gtim2_pin_m1" (GPIO88) and friends for
  that.

compatible: "loongson,ls2k-pwm-timer"

include: [pwm-controller.yaml, base.yaml]

properties:
  loongson,complementary-only:
    type: int
    description: |
      Bit mask of the PWM channels that drive their complementary output (CHxN)
      instead of their main output (CHx): bit 0 is the first channel, i.e. chip
      CH1, bit 2 is chip CH3. Channels that are not in the mask drive both of
      their outputs where the block has them.

      Only the ATIM has complementary outputs (CH1N..CH3N). Setting this on a
      block without them - the GTIM - makes the device fail to initialize, which
      is loud on purpose: the property would otherwise silently drive nothing.

      The pins themselves stay board wiring: a channel is only seen on a pin if
      the board muxes it (pinctrl-0 of the parent timer node). Note that the two
      outputs of a channel are switched without dead time; BDTR.DTG stays at
      zero.

      "loongson,complementary-only = <0x4>;" makes channel 3 (chip CH3) drive
      CH3N alone.
    default: 0

  "#pwm-cells":
    const: 3

pwm-cells:
  - channel
  # period in nanoseconds; the same two cells the vendor Linux node declares
  - period
  - flags
```

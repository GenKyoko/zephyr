## dts/bindings/rtc/loongson,ls2k0300-rtc.yaml
```yaml
# Copyright (c) 2026 Zephyr Project Contributors
# SPDX-License-Identifier: Apache-2.0

description: |
  Loongson 2K0300 real time clock.

  The block contains two counters: the TOY ("time of year") counter, which is
  the wall clock the driver reads and writes, and a free running counter clocked
  by the 32.768 kHz crystal. Register offsets within "reg" are the ones the
  2K0300 user manual documents in chapter 25 and match mainline Linux'
  rtc-loongson.c:

    0x20  sys_toytrim   must be written 0 by software
    0x24  sys_toywrite0 TOY value, write only
    0x28  sys_toywrite1 TOY year, write only
    0x2c  sys_toyread0  TOY value, read only
    0x30  sys_toyread1  TOY year, read only
    0x40  sys_rtcctrl   TOY/RTC/crystal enables plus write status
    0x60  sys_rtctrim   must be written 0 by software
    0x64  sys_rtcwrite0 RTC counter, write only
    0x68  sys_rtcread0  RTC counter, read only

  The 2K0300 variant has no working TOY match alarm (mainline Linux carries it
  under LOONGSON_RTC_ALARM_WORKAROUND and clears RTC_FEATURE_ALARM), so the
  block is used as a plain wall clock and no interrupt is described. The RTC
  interrupt sources the manual lists (RTC-INT0..2, RTC-TICK, TOY-TICK in the
  interrupt tables) stay unused for the same reason.

compatible: "loongson,ls2k0300-rtc"

include: [rtc-device.yaml, base.yaml]

properties:
  reg:
    required: true
```

## dts/bindings/spi/loongson,ls-spi-io.yaml
```yaml
# SPDX-License-Identifier: Apache-2.0

description: |
  Loongson 2K0300 SPI-IO master controller ("ls-spi-io", user manual chapter
  10), the register file of the SPI2 (0x1610c000) and SPI3 (0x1610e000)
  blocks - a different design from the "loongson,ls-spi" pair: 32 bit
  registers, a word count register (CSTART per byte with AUTOSUSPEND), and
  no hardware chip select lines at all (the vendor Linux driver drives the
  chip selects exclusively through "cs-gpios", and so does this port).

  Register file (vendor drivers/spi/spi-ls-io.c):

    0x00 CR1   spe(0) cstart(1) autosus(2) ssrev(8)
    0x04 CR2   rxfthlv(1:0) txfthlv(9:8) rxdmaen(7) txdmaen(15)
    0x08 CR3   mstr(0) dioswp(1) die(2) doe(3) ssmode(9:8)
    0x0c CR4
    0x10 IER
    0x14 SR1   rxa(0) txa(1) dxa(2) rxe(4) txe(5) susp(7) ovr(8) udr(9)
               crce(10) modf(11) eot(15, write 1 to clear)
    0x18 SR2   rxflv(2:0) txflv(10:8)
    0x20 CFG1  cpol(0) cpha(1) lsbfrst(7) dsize(12:8)
    0x24 CFG2  brdec(7:2) brint(15:8)  - the clock divider:
               divider = brint + brdec/64, register value (brint << 8)
    0x28 CFG3
    0x30/0x34 CRC1/CRC2
    0x40 DR    data register, BYTE wide on both access sides

  The per byte sequence the vendor driver runs: wait SR1.txa, write DR,
  set CR1 = spe | cstart | autosus, wait SR1.eot, write SR1.eot (clear),
  wait SR1.rxa, read DR.

  Divider: brint = clamp(DIV_ROUND_UP(ref_clk / sclk), 2, 255), so with the
  APB/DEVS clock (200 MHz on this board) SCLK runs from 100 MHz down to
  about 784 kHz in this port.

compatible: "loongson,ls-spi-io"

include: [spi-controller.yaml, base.yaml, pinctrl-device.yaml]

properties:
  reg:
    required: true

  clocks:
    required: true

  clock-names:
    required: false
```

## dts/bindings/spi/loongson,ls-spi.yaml
```yaml
# SPDX-License-Identifier: Apache-2.0

description: |
  Loongson 2K0300 SPI master controller ("ls-spi", user manual chapter 9).

  The block is a simple polled SPI master: one byte-wide TX/RX FIFO port, a
  clock divider built from two two bit fields (SPCR.spr / SPER.spre, the
  divisions of table 9-7: 2, 4, 8, 16, 32, 64, 128, 256, 512, 1024, 2048,
  4096) and up to four hardware chip selects driven through the SFC_SOFTCS
  register (low nibble: which csn lines software controls, high nibble: the
  line values).

  Register file layout:

    0x00 SPCR      control: spie(7) spe(6) mstr(4) cpol(3) cpha(2) spr(1:0)
    0x01 SPSR      status: spif(7,w1c) wcol(6,w1c) wffull(3) wfempty(2)
                   rffull(1) rfempty(0)
    0x02 FIFO      TX port on write, RX port on read
    0x03 SPER      external: icnt(7:6) mode(2) spre(1:0)
    0x04 SFC_PARAM parameter: bit 0 memory_en (reset 1 - it has to be cleared
                   before the chip select lines answer to SFC_SOFTCS)
    0x05 SFC_SOFTCS  chip select: csen(3:0) csn(7:4)
    0x06 SFC_TIMING  flash timing, left at its reset value

  On the 2K0300 the controller input is the APB/DEVS bus clock, 200 MHz on
  this board, so the divider covers SCLK from 100 MHz down to about 49 kHz.

  The same register file as "loongson,ls2k1000-spi" in mainline Linux
  (drivers/spi/spi-loongson-core.c), whose platform driver matches that one
  compatible; the 2K0300 vendor device tree names it "loongson,ls-spi" and
  this binding follows the vendor name so the device trees stay sharable.

  Not covered here: the two "loongson,ls-spi-io" blocks (SPI2/SPI3) whose
  register file additionally exposes the flash memory window in QSPI mode,
  and the memory-mapped (XIP) flash mode of SPI0 - the driver runs the
  controller as a plain SPI master.

compatible: "loongson,ls-spi"

include: [spi-controller.yaml, base.yaml, pinctrl-device.yaml]

properties:
  reg:
    required: true

  clocks:
    required: true

  clock-names:
    required: false
```

## dts/bindings/timer/loongson,loongson-timers.yaml
```yaml
# SPDX-License-Identifier: Apache-2.0

description: |
  Loongson 2K0300 timer block ("ATIM" and "GTIM" in the SoC user manual,
  chapters 18 and 19; "timers1" and "timers2" in the vendor device tree).

  Each block is an STM32 style general purpose timer: a 32 bit auto reload
  counter with prescaler, four channels that can capture inputs or drive
  outputs (output compare / PWM), encoder mode, and DMA request lines. The
  blocks are clocked by the APB bus (LS2K0300_CLK_APB) and raise one interrupt
  each, on the extended interrupt controller:

    0x1611_8000  ATIM   EIOINTC vector 25   flat IRQ 41
    0x1611_9000  GTIM   EIOINTC vector 26   flat IRQ 42
    0x1611_a000  BTIM   EIOINTC vector 27   flat IRQ 43

  (BTIM exists in the SoC but has no node in the vendor device tree, so the
  2K0300 device tree describes the first two only.)

  Node name, label and compatible come from the vendor device tree
  (arch/loongarch/boot/dts/loongson-2k0300.dtsi): mainline Linux has no 2K0300
  device tree yet, so there is no mainline naming to prefer. In Linux the block
  is an MFD parent (drivers/mfd/loongson-timers.c) that populates a "pwm" child
  ("loongson,ls2k-pwm-timer", drivers/pwm/pwm-ls-timer.c), and boards enable the
  node and its child and assign the channel pins through pinctrl.

compatible: "loongson,loongson-timers"

include: [base.yaml, pinctrl-device.yaml]

properties:
  reg:
    required: true

  interrupts:
    required: true

  clocks:
    required: true

  clock-names:
    required: true
```

## soc/loongson/ls2k0300/Kconfig
```kconfig
# SPDX-License-Identifier: Apache-2.0

config SOC_FAMILY_LS2K300
	select LOONGARCH
	select GEN_SW_ISR_TABLE

if SOC_FAMILY_LS2K300

rsource "*/Kconfig"

config LOONGARCH_UBOOT_UIMAGE
	bool "Generate a u-boot legacy uImage (zephyr.uImage)"
	select BUILD_OUTPUT_BIN
	default y
	help
	  Emit an additional zephyr.uImage in the u-boot legacy image format so
	  that the 2K0300 boards can be booted with the same flow as the vendor
	  kernel, e.g.

	    tftpboot ${loadaddr} zephyr.uImage
	    bootm ${loadaddr}

	  u-boot calls the LoongArch architecture "loongarch" in its image
	  architecture table, so a plain legacy uImage works for LoongArch too.
	  The header is produced by soc/loongson/ls2k0300/gen_uimage.py, which
	  takes the load address and the entry point from zephyr.elf; u-boot
	  relocates the payload to the load address stored in the header, so
	  the file can be transferred to any free address first.

config LS2K0300_RX_CHECK
	bool "Console receive interrupt self check"
	help
	  Run one non blocking check three seconds after the application starts,
	  from a work queue item so it cannot starve anything:

	    1. print IER / IIR / LSR plus the EIOINTC enable, routing, device
	       status and routed status, and ESTAT,
	    2. put the console UART into internal loopback (MCR bit 4) and write
	       one byte to it,

	  so the byte comes back as received data. If the receive interrupt path
	  works the driver ISR takes it immediately and LSR.DR reads 0 and ESTAT
	  has long settled; if the byte is still sitting in the FIFO with ESTAT
	  clear, then the UART is not asking for an interrupt at all, and if
	  ESTAT is set while the byte stays, the dispatch is the break.

	  Needed because every static check said the path was enabled - IER bit 0
	  set, EIOINTC vector 0 enabled, ECFG bit 3 set, paging off - while the
	  shell never received a character.

config LS2K0300_CONSOLE_GUARD
	bool "Watch the console UART and repair it"
	default y
	help
	  Check the console UART once a second from the system work queue and
	  repair the states that make the shell look dead while the rest of the
	  system keeps running:

	    - the receive pin no longer on function 3, i.e. moved out of uart0_rx
	      by something writing the pin mux field (the SoC itself comes up
	      with the pin in its GPIO setting). The console keeps printing
	      because the transmitter's field is still right, and nothing at all
	      arrives. The field is written back.
	    - the UART left in internal loopback (MCR.LOOP set, and OUT2 clear
	      with it): the receiver is off the RX pin, so the keyboard never
	      arrives, while the shell's own output is fed straight back into the
	      receiver. MCR is written back to DTR | RTS | OUT2.
	    - a received byte that nobody serves for two ticks: a receive
	      interrupt that was lost on the way to the driver. IER is toggled so
	      the UART raises the request again.
	    - shell output queued (IER.TBE set) while the transmitter sits idle
	      (THRE set) for two ticks: the empty-transmitter request never came.
	      IER.TBE is toggled so the UART raises it.
	    - a transmitter that stays busy for three ticks: both FIFOs are
	      cleared and the modem lines are written back, the only thing left
	      to try when the shift register is stuck.

	  The guard only writes when it repairs something and reports nothing:
	  a console error cannot be announced over the console itself, and a
	  repaired console needs no announcement. Each repair is recorded with
	  LOG_DBG, which the default runtime log level keeps out of the console.

	  Note: the bring-up receive check (LS2K0300_RX_CHECK) uses internal
	  loopback on purpose and can trip this guard; keep the two apart.

config LS2K0300_IRQ_DIAG
	bool "Bring-up: dump the interrupt CSRs and time a few sleeps"
	default n
	help
	  Print CRMD/PRMD/ECFG/ESTAT over the console at APPLICATION init and then
	  sleep three times, so interrupt delivery can be checked from the console
	  alone. A bring-up aid: keep it off in production images.

endif # SOC_FAMILY_LS2K300
```

## soc/loongson/ls2k0300/ls2k0300/Kconfig.soc
```kconfig
# Copyright (c) 2026 Zephyr Project Contributors
# SPDX-License-Identifier: Apache-2.0

config SOC_LS2K0300
	bool
	select SOC_FAMILY_LS2K300

config SOC
	default "ls2k0300" if SOC_LS2K0300
```

## soc/loongson/ls2k300/Kconfig.soc
```kconfig
# Copyright (c) 2026 Zephyr Project Contributors
# SPDX-License-Identifier: Apache-2.0

config SOC_FAMILY_LS2K300
	bool

config SOC_FAMILY
	default "ls2k300" if SOC_FAMILY_LS2K300

rsource "*/Kconfig.soc"
```

## soc/qemu/virt_loongarch/Kconfig
```kconfig
# SPDX-License-Identifier: Apache-2.0

config SOC_FAMILY_QEMU_VIRT_LOONGARCH
	select LOONGARCH

if SOC_FAMILY_QEMU_VIRT_LOONGARCH

rsource "*/Kconfig"

endif # SOC_FAMILY_QEMU_VIRT_LOONGARCH
```

## soc/qemu/virt_loongarch/Kconfig.soc
```kconfig
# SPDX-License-Identifier: Apache-2.0

config SOC_FAMILY_QEMU_VIRT_LOONGARCH
	bool

config SOC_FAMILY
	default "qemu_virt_loongarch" if SOC_FAMILY_QEMU_VIRT_LOONGARCH

rsource "*/Kconfig.soc"
```

## boards/loongson/ls2k300_pai/Kconfig.ls2k300_pai
```kconfig
# SPDX-License-Identifier: Apache-2.0

config BOARD_LS2K300_PAI
	select SOC_LS2K0300
```

## boards/loongson/ls2k300_pai/board.yml
```yaml
board:
  name: ls2k300_pai
  full_name: Loongson 2K0300 PAI (LS2K300-PAI)
  vendor: loongson
  socs:
    - name: ls2k0300
```

## boards/qemu/loongarch64/Kconfig
```kconfig
# Copyright (c) 2026 Zephyr Project Contributors
# SPDX-License-Identifier: Apache-2.0

config BOARD_QEMU_LOONGARCH64
	select QEMU_TARGET
```

## boards/qemu/loongarch64/Kconfig.qemu_loongarch64
```kconfig
# SPDX-License-Identifier: Apache-2.0

config BOARD_QEMU_LOONGARCH64
	select SOC_QEMU_VIRT_LOONGARCH64
```

## boards/qemu/loongarch64/board.yml
```yaml
board:
  name: qemu_loongarch64
  full_name: QEMU Emulation for LoongArch64
  vendor: qemu
  socs:
    - name: qemu_virt_loongarch64
```

## drivers/audio/Kconfig.es8388
```kconfig
# SPDX-License-Identifier: Apache-2.0

config AUDIO_CODEC_ES8388
	bool "Everest ES8388 codec driver"
	default y
	select I2C
	depends on DT_HAS_EVEREST_ES8388_ENABLED
	help
	  Enable the driver for the Everest ES8388 stereo audio codec, whose
	  control interface is I2C and whose data interface is I2S.

	  The register model follows the ES8328, which is also what Linux drives
	  for the "everest,es8388" compatible. Playback (DAC) and capture (ADC)
	  are implemented with I2S/left/right justified formats, 16/18/20/24/32
	  bit words, the sample rates of a 12.288 MHz and an 11.2896 MHz system
	  clock, master or target role, and output/input volume and mute.
```

## drivers/clock_control/Kconfig.loongson_ls2k0300
```kconfig
# SPDX-License-Identifier: Apache-2.0

config CLOCK_CONTROL_LOONGSON_LS2K0300
	bool "Loongson 2K0300 clock controller"
	default y
	depends on DT_HAS_LOONGSON_LS2K0300_CLK_ENABLED
	help
	  Clock controller of the Loongson 2K0300 (LS2K300 family). It reports
	  the frequencies the SoC PLLs and the per bus frequency scalers are
	  running at, so device trees do not have to hard code them, and it
	  gates the PLL output enables. Setting rates is not supported: the PLLs
	  are locked by the boot loader and are deliberately left alone.

if CLOCK_CONTROL_LOONGSON_LS2K0300

config CLOCK_CONTROL_LOONGSON_LS2K0300_INIT_PRIORITY
	int "Loongson 2K0300 clock controller init priority"
	default 35
	help
	  The clock controller asks its parent reference clock (a fixed-clock,
	  which initialises at CONFIG_CLOCK_CONTROL_INIT_PRIORITY) for its rate,
	  so it has to come after it, and before the devices that ask the
	  controller for their rate - in particular the console NS16550 at
	  CONFIG_SERIAL_INIT_PRIORITY (50 by default).

endif # CLOCK_CONTROL_LOONGSON_LS2K0300
```

## drivers/dma/Kconfig.loongson_lsia
```kconfig
# Loongson LSIA DMA Driver configuration

# SPDX-License-Identifier: Apache-2.0

config DMA_LOONGSON_LSIA
	bool "Loongson LSIA DMA controller driver"
	default y
	depends on DT_HAS_LOONGSON_LSIA_DMA_ENABLED
	help
	  Enable the eight channel DMA controller of the Loongson 2K0300
	  ("loongson,lsia-dma", user manual chapter 12), whose data requests
	  are wired to fixed channels - the I2S transmit on channel 1 and its
	  receive on channel 0. One interrupt line per channel.

if DMA_LOONGSON_LSIA

config DMA_LOONGSON_LSIA_INIT_PRIORITY
	int "Loongson LSIA DMA init priority"
	default 50
	help
	  The channel interrupts are routed through the EIOINTC, whose
	  initialization masks every vector before it registers itself - a
	  driver that enables its lines earlier silently loses them (the
	  arch_irq_enable() of an unregistered secondary controller does
	  nothing). This has to sit after CONFIG_INTC_INIT_PRIORITY; the
	  default does, with the EIOINTC at its default 40.

endif
```

## drivers/gpio/Kconfig.loongson_ls2k0300
```kconfig
# SPDX-License-Identifier: Apache-2.0

config GPIO_LOONGSON_LS2K0300
	bool "Loongson LS2K0300 GPIO driver"
	default y
	depends on DT_HAS_LOONGSON_LS2K0300_GPIO_ENABLED
	help
	  Driver for the "byte controlled" GPIO block of the Loongson 2K0300
	  (and compatible 2K series SoCs), register layout as in the mainline
	  Linux driver drivers/gpio/gpio-loongson-64bit.c. Interrupt support
	  is not implemented yet.
```

## drivers/i2c/Kconfig.loongson_ls2k0300
```kconfig
# SPDX-License-Identifier: Apache-2.0

config I2C_LOONGSON_LS2K0300
	bool "Loongson 2K0300 I2C driver"
	default y
	depends on DT_HAS_LOONGSON_LS2K0300_I2C_ENABLED
	help
	  I2C controller driver for the Loongson 2K0300 "fast I2C" peripheral:
	  32 bit registers (CR1/CR2/DR/SR1/SR2/CCR/TRISE), start/stop/ack through
	  CR1, level status flags in SR1/SR2 - all polled, so no interrupt line is
	  needed:

	    i2c1: i2c@8000000016109000 {
	            compatible = "loongson,ls2k0300-i2c";
	            clocks = <&clk LS2K0300_CLK_I2C>;
	            clock-frequency = <100000>;
	            ...
	    };
```

## drivers/i2s/Kconfig.loongson_ls2k0300
```kconfig
# SPDX-License-Identifier: Apache-2.0

config I2S_LOONGSON_LS2K0300
	bool "Loongson 2K0300 I2S driver"
	default y
	depends on DT_HAS_LOONGSON_LS2K0300_I2S_ENABLED
	select DMA
	help
	  Enable the Loongson 2K0300 I2S controller ("IIS", user manual chapter
	  11) as a stereo, I2S format, master or slave controller.

	  The data path runs on the LSIA DMA controller (the eight channel
	  engine at 0x1612c000): one circular channel per direction over a two
	  block ring, paced by the controller's own data requests, with the
	  half and wrap boundaries arriving as interrupts. i2s_write() blocks
	  only until the engine is done with the ring half it refills. The
	  transmit and receive interrupts of the block itself stay disabled -
	  they report FIFO overflow/underflow, which cannot be used as a
	  pacing signal.
```

## drivers/interrupt_controller/Kconfig.eiointc
```kconfig
# SPDX-License-Identifier: Apache-2.0

config INTC_EIOINTC
	bool "Loongson EIOINTC (extended I/O interrupt controller)"
	default y
	depends on DT_HAS_LOONGSON_LS2K0300_EIOINTC_ENABLED
	select LOONGARCH
	help
	  Enable the driver for the Loongson EIOINTC (extended I/O interrupt
	  controller, "EXTIOI" on the 2K0300). The controller provides up to 128
	  independent peripheral interrupt vectors and forwards them to a single
	  LoongArch CPU interrupt line.

	  It is the successor of the LIOINTC, which aggregates 32 peripheral
	  lines onto one CPU line, several of which the SoC wires to a group of
	  peripherals (uart2..uart5 share one line on the 2K0300). With the
	  static ISR table of this port only one handler can serve such a line,
	  so peripherals that need their own interrupt should use the EIOINTC.
```

## drivers/interrupt_controller/Kconfig.liointc
```kconfig
# Copyright (c) 2026 Zephyr Project Contributors
# SPDX-License-Identifier: Apache-2.0

config INTC_LIOINTC
	bool "Loongson LIOINTC interrupt controller"
	default y
	depends on DT_HAS_LOONGSON_LIOINTC_2_0_ENABLED
	select LOONGARCH
	help
	  Enable the driver for the Loongson LIOINTC (Local I/O interrupt
	  controller), version 2.0, used on the 2K0300 and other Loongson
	  SoCs. The controller aggregates 32 peripheral interrupt lines onto
	  a single LoongArch CPU interrupt line.
```

## drivers/pwm/Kconfig.loongson_ls_timer
```kconfig
# Copyright (c) 2026 Zephyr Project Contributors
# SPDX-License-Identifier: Apache-2.0

config PWM_LOONGSON_LS_TIMER
	bool "Loongson 2K0300 ATIM/GTIM PWM driver"
	default y
	depends on DT_HAS_LOONGSON_LS2K_PWM_TIMER_ENABLED
	help
	  Enable the PWM front end of the Loongson 2K0300 ATIM/GTIM timer blocks.
	  The driver is bound to the "loongson,ls2k-pwm-timer" child node of a
	  "loongson,loongson-timers" block, which is how the vendor device tree
	  and Linux describe it (drivers/mfd/loongson-timers.c plus
	  drivers/pwm/pwm-ls-timer.c); registers, clock and pinctrl are taken from
	  that parent node.

	  The number of channels and the width of the auto reload register are
	  probed at run time. Capture, break inputs and the complementary outputs
	  of the ATIM are not implemented.
```

## drivers/rtc/Kconfig.loongson_ls2k0300
```kconfig
# Copyright (c) 2026 Zephyr Project Contributors
# SPDX-License-Identifier: Apache-2.0

config RTC_LOONGSON_LS2K0300
	bool "Loongson 2K0300 RTC driver"
	default y
	depends on DT_HAS_LOONGSON_LS2K0300_RTC_ENABLED
	help
	  Enable the driver for the real time clock of the Loongson 2K0300. It
	  drives the battery backed TOY ("time of year") counter, which counts
	  year/month/day/hour/minute/second with 0.1 s resolution off the
	  32.768 kHz crystal.

	  The 2K0300 RTC does not support the TOY match alarms, so the driver
	  implements the wall clock only; mainline Linux treats this variant the
	  same way (drivers/rtc/rtc-loongson.c, LOONGSON_RTC_ALARM_WORKAROUND).
```

## drivers/spi/Kconfig.loongson_ls2k0300
```kconfig
# Loongson 2K0300 SPI Driver configuration options

# SPDX-License-Identifier: Apache-2.0

config SPI_LOONGSON_LS2K0300
	bool "Loongson 2K0300 SPI controller driver"
	default y
	depends on DT_HAS_LOONGSON_LS_SPI_ENABLED
	help
	  Enable the polled SPI master of the Loongson 2K0300 (the
	  "loongson,ls-spi" blocks at 0x16010000/0x16018000, user manual
	  chapter 9). The two "loongson,ls-spi-io" blocks (SPI2/SPI3) are a
	  different register file and are not covered.
```

## drivers/spi/Kconfig.loongson_ls_io
```kconfig
# Loongson 2K0300 SPI-IO Driver configuration options

# SPDX-License-Identifier: Apache-2.0

config SPI_LOONGSON_LS_IO
	bool "Loongson 2K0300 SPI-IO controller driver"
	default y
	depends on DT_HAS_LOONGSON_LS_SPI_IO_ENABLED
	help
	  Enable the polled SPI-IO master of the Loongson 2K0300 (the
	  "loongson,ls-spi-io" blocks at 0x1610c000/0x1610e000, user manual
	  chapter 10 - the SPI2/SPI3 register file, a different design from
	  the SPI0/SPI1 "loongson,ls-spi" pair). Chip selects come from
	  "cs-gpios" only; the block has none of its own.
```

## drivers/timer/Kconfig.loongarch
```kconfig
#
# SPDX-License-Identifier: Apache-2.0

config LOONGARCH_CONSTANT_TIMER
	bool "LoongArch constant timer"
	default y
	depends on LOONGARCH
	select TICKLESS_CAPABLE
	select TIMER_HAS_64BIT_CYCLE_COUNTER
	help
	  This module implements the LoongArch constant frequency timer as the
	  Zephyr system clock. The countdown timer is programmed through
	  CSR.TCFG and acked through CSR.TICLR, while the stable counter
	  (rdtime.d) provides the free-running 64-bit cycle count.
```

## dts/bindings/audio/everest,es8388.yaml
```yaml
# SPDX-License-Identifier: Apache-2.0

description: |
  Everest Semiconductor ES8388 stereo audio codec (I2C control interface).

  The codec's data interface is I2S: BCLK, LRCLK and the data lines are wired to
  an I2S controller, and the control registers are reached over I2C, which is
  what this binding and driver cover. Whether the codec or the I2S controller
  drives BCLK/LRCLK is decided at runtime, through the frame clock and bit clock
  options of the configuration the application passes to
  audio_codec_configure(); the 2K0300 board this port runs on has the controller
  as the master, so the codec is configured as the target.

  The register model follows the ES8328, which is the part Linux drives for the
  "everest,es8388" compatible as well (sound/soc/codecs/es8328.c and
  es8328-i2c.c); the driver notes the registers whose meaning differs between
  the two parts.

compatible: "everest,es8388"

include: [i2c-device.yaml, base.yaml]

properties:
  reg:
    required: true

  mclk-frequency:
    type: int
    description: |
      Frequency of the codec's system clock (MCLK) on this board, in Hz. The
      driver uses it to check the configuration requests against the sample
      rate tables it has (12.288 MHz and 11.2896 MHz are the two families the
      part supports); the 2K0300 board clocks its codec from a fixed 12.288 MHz
      oscillator.
```

## dts/bindings/clock/loongson,ls2k0300-clk.yaml
```yaml
# Copyright (c) 2026 Zephyr Project Contributors
# SPDX-License-Identifier: Apache-2.0

description: |
  Loongson 2K0300 (and the other 2K series SoCs sharing the IP) clock
  controller.

  The controller is the register block at 0x1600_0400 holding the three PLL
  configurations (NODE, DDR, PIX), the per bus frequency scalers and the PLL
  output enables. It is driven read only: the boot loader has already locked
  the PLLs, so the driver reports the resulting rates and gates the output
  enables but never sets a rate.

  Clock consumers reference it with

    clocks = <&clk LS2K0300_CLK_APB>;

  where the cell is one of the clock IDs of
  include/zephyr/dt-bindings/clock/loongson,ls2k0300-clk.h. The reference
  oscillator is the parent clock (a fixed-clock in the SoC device tree).

compatible: "loongson,ls2k0300-clk"

include: [clock-controller.yaml, base.yaml]

properties:
  reg:
    required: true

  clocks:
    required: true

  clock-names:
    required: true

clock-cells:
  - clkid
```

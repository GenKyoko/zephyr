## soc/qemu/virt_loongarch/qemu_virt_loongarch64/Kconfig.soc
```kconfig
# Copyright (c) 2026 Zephyr Project Contributors
# SPDX-License-Identifier: Apache-2.0

config SOC_QEMU_VIRT_LOONGARCH64
	bool
	select SOC_FAMILY_QEMU_VIRT_LOONGARCH

config SOC
	default "qemu_virt_loongarch64" if SOC_QEMU_VIRT_LOONGARCH64
```
